; write_image.cmm — reached by flash.cmm's Program subroutine via `DO write_image`.
  DO common
  ENDDO
