; init.cmm — board bring-up. Reached by flash.cmm via `DO init`.
  DO common               ; static DO -> common.cmm is kept
  ENDDO
